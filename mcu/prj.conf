## CMakeLists.txt
```
# SPDX-License-Identifier: Apache-2.0
cmake_minimum_required(VERSION 3.20.0)

set(BOARD stm32f4_disco)

# =============================================================================
# AUTOMATIC OVERLAY SELECTION
# =============================================================================

# Select configuration overlay based on build type
if(NOT DEFINED OVERLAY_CONFIG)
    if(CMAKE_BUILD_TYPE STREQUAL "Release")
        set(OVERLAY_CONFIG "conf/release.conf")
        message(STATUS "🚀 RELEASE BUILD: Using release.conf overlay")
    elseif(CMAKE_BUILD_TYPE STREQUAL "Debug")
        set(OVERLAY_CONFIG "conf/debug.conf")  
        message(STATUS "🐛 DEBUG BUILD: Using debug.conf overlay")
    else()
        # Default to debug if build type not specified or unknown
        set(OVERLAY_CONFIG "conf/debug.conf")
        message(STATUS "❓ UNKNOWN BUILD TYPE '${CMAKE_BUILD_TYPE}': Defaulting to debug.conf")
    endif()
    
    message(STATUS "Configuration files:")
    message(STATUS "  Base: prj.conf")
    message(STATUS "  Overlay: ${OVERLAY_CONFIG}")
else()
    message(STATUS "📝 MANUAL OVERRIDE: Using overlay ${OVERLAY_CONFIG}")
endif()

# Include extra/custom modules via kconfig (libraries)
# set(ZEPHYR_EXTRA_MODULES "${CMAKE_CURRENT_SOURCE_DIR}/../../modules/moduleName")
find_package(Zephyr REQUIRED HINTS $ENV{ZEPHYR_BASE})

# Name the project
project (
    smart_roomba_mcu
    DESCRIPTION "Real-time control for Smart Roomba"
    VERSION 0.1.0
    LANGUAGES C
)

# Add your C source files here
FILE(GLOB app_sources src/*.c)
target_sources(app PRIVATE ${app_sources})

# Add include directory directly instead of using header files
target_include_directories(app PRIVATE inc)

# =============================================================================
# APPLICATION-LEVEL DEBUG MACROS
# =============================================================================

# Define application-level DEBUG macro (separate from Zephyr's CONFIG_DEBUG)
if(CMAKE_BUILD_TYPE STREQUAL "Debug")
    target_compile_definitions(app PRIVATE DEBUG=1)
    message(STATUS "✅ Application DEBUG macro enabled")
elseif(CMAKE_BUILD_TYPE STREQUAL "Release")
    target_compile_definitions(app PRIVATE NDEBUG=1)
    message(STATUS "✅ Application NDEBUG macro enabled")
endif()

# Generate a Unix timestamp for the build
string(TIMESTAMP BUILD_TIMESTAMP_UNIX "%s")
target_compile_definitions(app PRIVATE 
    BUILD_TYPE="${CMAKE_BUILD_TYPE}"
    BUILD_TIMESTAMP="${BUILD_TIMESTAMP_UNIX}"
)
```

## west.yml
```
manifest:
  version: "0.13"

  defaults:
    remote: upstream

  remotes:
    - name: upstream
      url-base: https://github.com/zephyrproject-rtos

  projects:
    - name: zephyr
      remote: upstream
      repo-path: zephyr
      revision: main
      import: true

  self:
    path: smart-roomba/mcu
```

## prj.conf
```kconfig
# SPDX-License-Identifier: Apache-2.0

# This is the base Kconfig file for the Zephyr project
# The settings here are common to ALL builds

# Logging system (level will be overridden by overlays)
CONFIG_LOG=y
CONFIG_LOG_MODE_DEFERRED=y
CONFIG_LOG_PROCESS_THREAD=y
CONFIG_LOG_BUFFER_SIZE=4096

# FSM
CONFIG_SMF=y
CONFIG_EVENTS=y

# Console and UART (needed for all builds)
CONFIG_CONSOLE=y
CONFIG_UART_CONSOLE=y # It uses the default UART for console output. Refer to stm32f4_disco.dts
CONFIG_SERIAL=y

# GPIO (essential for LED control)
CONFIG_GPIO=y
CONFIG_GPIO_STM32=y

# Counter / timer
CONFIG_COUNTER=y
CONFIG_COUNTER_TIMER_STM32=y

# Testing
CONFIG_ASSERT=y

# Application-specific features that all builds need
# Add any drivers/features your Smart Roomba always needs:
# CONFIG_I2C=y
# CONFIG_SPI=y
# CONFIG_PWM=y
```

## boards/stm32f4_disco.conf
```kconfig
# This contains the Kconfig settings for the stm32_disco board.
# To include additional kconfig options: run `west build -b stm32_disco -- -DEXTRA_CONF_FILE=boards/stm32f4_discovery.conf`
```

## boards/stm32f4_discovery.conf
```kconfig
# This contains the Kconfig settings for the STM32F4 Discovery board.
# To include additional kconfig options: run `west build -b stm32f4_discovery -- -DEXTRA_CONF_FILE=boards/stm32f4_discovery.conf`
```

## app.overlay
```dts
/*
 * Copyright (c) 2024 Smart Roomba Project
 *
 * SPDX-License-Identifier: Apache-2.0
 */

/*
 * Device tree overlay for Smart Roomba application
 * This file can be used to configure hardware-specific settings
 * that override the base board configuration.
 */

/ {
	aliases {
		/* Define aliases for commonly used peripherals */
		/* Example: motor-left = &pwm1; */
		/* Example: motor-right = &pwm2; */
		/* Example: sensor-distance = &i2c1; */
		counter0 = &tim2_counter;  /* Use TIM2 as counter0 */
	};

	/* Application-specific GPIO configurations can go here */
	/* Example:
	gpio_keys {
		compatible = "gpio-keys";
		button0: button_0 {
			gpios = <&gpio0 11 (GPIO_PULL_UP | GPIO_ACTIVE_LOW)>;
			label = "Push button switch 0";
		};
	};
	*/
};

&timers2 {
	status = "okay";
	st,prescaler = <83>; // 84 MHz

	tim2_counter: counter {
		compatible = "st,stm32-counter";
		status = "okay";
		label = "COUNTER_2";       /* or any label you like */
	};
};
```

## src/main.c
```c
/**
 * @file    main.c
 * @brief   Smart Roomba MCU main file
 * @author  Jacky Lim
 * @date    June 2025
 * @details This file initializes the LEDs on the STM32F4 Discovery board
 * 
 */

#include <zephyr/kernel.h>
#include <zephyr/device.h>
#include <zephyr/devicetree.h>
#include <zephyr/drivers/gpio.h>
#include <zephyr/logging/log.h>

LOG_MODULE_REGISTER(smart_roomba, LOG_LEVEL_INF);

/* 1000 msec = 1 sec */
#define SLEEP_TIME_MS   1000

/* The devicetree node identifiers for all 4 LEDs on STM32F4 Discovery */
#define LED0_NODE DT_ALIAS(led0)  /* Green LED (LD4) */
#define LED1_NODE DT_ALIAS(led1)  /* Orange LED (LD3) */
#define LED2_NODE DT_ALIAS(led2)  /* Red LED (LD5) */
#define LED3_NODE DT_ALIAS(led3)  /* Blue LED (LD6) */

/*
 * GPIO specifications for all 4 LEDs on STM32F4 Discovery board
 */
static const struct gpio_dt_spec leds[] = {
	GPIO_DT_SPEC_GET(LED0_NODE, gpios),  /* Green LED */
	GPIO_DT_SPEC_GET(LED1_NODE, gpios),  /* Orange LED */
	GPIO_DT_SPEC_GET(LED2_NODE, gpios),  /* Red LED */
	GPIO_DT_SPEC_GET(LED3_NODE, gpios),  /* Blue LED */
};

#define NUM_LEDS ARRAY_SIZE(leds)

int main(void)
{
    // Always available - Zephyr's logging system
    LOG_INF("Smart Roomba MCU starting...");
    
#ifdef DEBUG // This is defined in the CMakeLists.txt for debug builds
    // Only in CMake Debug builds - your custom debug code for application level code
    LOG_DBG("Debug build - enabling verbose diagnostics");
    // Custom debug initialization
    // debug_print_system_info();
    // enable_performance_monitoring();
#endif

#ifdef CONFIG_DEBUG  // This is defined in prj.conf for debug builds
    // Only when Zephyr debug is enabled - system debug.
	// Used for kernel debugging, assertions, etc.
    LOG_DBG("Zephyr debug features enabled");
    // This will show thread info, kernel assertions, etc.
#endif

	int ret;
	static int led_pattern = 0;

	LOG_INF("Initializing all LEDs on STM32F4 Discovery board");

	/* Initialize all LEDs */
	for (int i = 0; i < NUM_LEDS; i++) {
		if (!gpio_is_ready_dt(&leds[i])) {
			LOG_ERR("LED %d device not ready", i);
			return -ENODEV;
		}

		ret = gpio_pin_configure_dt(&leds[i], GPIO_OUTPUT_ACTIVE);
		if (ret < 0) {
			LOG_ERR("Failed to configure LED %d pin", i);
			return ret;
		}
		
		LOG_INF("LED %d initialized successfully", i);
	}

	LOG_INF("Smart Roomba MCU initialization complete - all LEDs ready");
	
	const char* led_names[] = {"Green", "Orange", "Red", "Blue"};

	while (1) {
		/* Turn off all LEDs first */
		for (int i = 0; i < NUM_LEDS; i++) {
			gpio_pin_set_dt(&leds[i], 0);
		}

		/* Create a rotating pattern - turn on LEDs one by one */
		gpio_pin_set_dt(&leds[led_pattern], 1);
		
		LOG_DBG("LED pattern: %s LED ON", led_names[led_pattern]);
		
		led_pattern = (led_pattern + 1) % NUM_LEDS;
		
		k_msleep(SLEEP_TIME_MS);
		// k_sleep(K_FOREVER); // main loop should be sleeping forever
	}

	return 0;
}
```

## inc/state_machine.h
```c
/**
 ********************************************************************************
 * @file    state_machine.h
 * @author  Jacky Lim
 * @date    July 2025
 * @brief   State machine header for Smart Roomba MCU
 ********************************************************************************
 */

#ifndef STATE_MACHINE_H
#define STATE_MACHINE_H

/************************************
 * INCLUDES
 ************************************/
#include <stdint.h>
/************************************
 * MACROS AND DEFINES
 ************************************/
/* Define event bits */
#define EVT_PI_START        BIT(0)  // Pi says: start moving
#define EVT_PI_STOP         BIT(1)  // Pi says: stop moving
#define EVT_OBSTACLE        BIT(2)  // Sensor: obstacle detected
#define EVT_OBSTACLE_CLEAR  BIT(3)  // Sensor: obstacle cleared
#define EVT_LOW_BATTERY     BIT(4)  // Battery: critically low
#define EVT_DOCK_FOUND      BIT(5)  // IR sensor: dock detected

/************************************
 * TYPEDEFS
 ************************************/
/* Define state enum */
typedef enum {
    STATE_IDLE,
    STATE_ACTIVE,   // Following Pi's command
    STATE_FAULT,
    STATE_AVOIDING,
    STATE_MAX
} robot_state_t;

/************************************
 * EXPORTED VARIABLES
 ************************************/

/************************************
 * GLOBAL FUNCTION PROTOTYPES
 ************************************/
/* Public API */
void sm_post(uint32_t event_bits);        /* thread or ISR safe */
void sm_post_obstacle(void);              /* convenience helpers (optional) */
void sm_post_obstacle_clear(void);
void sm_post_low_battery(void);

/* Test API */
int sm_test_get_state(void);
void sm_test_init(void);        /* initializes FSM but doesn't start forever loop */
void sm_test_run_step(void);    /* calls smf_run_state() once */
#endif // STATE_MACHINE_H
```

## src/button_test.c
```c
/**
 * @file    button_test.c
 * @brief   Button testing for state machine
 * @details Uses the blue user button to cycle through FSM events
 */

#include <zephyr/kernel.h>
#include <zephyr/device.h>
#include <zephyr/drivers/gpio.h>
#include <zephyr/logging/log.h>

#include "state_machine.h"

LOG_MODULE_REGISTER(button_test, LOG_LEVEL_DBG);

/* Button definitions for STM32F4-DISC1 */
#define USER_BUTTON_NODE DT_ALIAS(sw0)
static const struct gpio_dt_spec button = GPIO_DT_SPEC_GET_OR(USER_BUTTON_NODE, gpios, {0});
static struct gpio_callback button_cb_data;

/* Test event sequence */
static uint32_t test_events[] = {
    BIT(0),  // EVT_PI_START
    BIT(2),  // EVT_OBSTACLE  
    BIT(3),  // EVT_OBSTACLE_CLEAR
    BIT(1),  // EVT_PI_STOP
    BIT(4),  // EVT_LOW_BATTERY
    BIT(0),  // EVT_PI_START (again)
};

static uint8_t event_index = 0;

void button_pressed(const struct device *dev, struct gpio_callback *cb, uint32_t pins)
{
    LOG_INF("🔘 Button pressed! Sending event %d", event_index);
    
    /* Post the current test event */
    sm_post(test_events[event_index]);

    /* Move to next event (cycle through) */
    event_index = (event_index + 1) % ARRAY_SIZE(test_events);
    
    LOG_INF("Next button press will send event %d", event_index);
}

int button_init(void)
{
    int ret;

    if (!gpio_is_ready_dt(&button)) {
        LOG_ERR("Button device not ready");
        return -ENODEV;
    }

    ret = gpio_pin_configure_dt(&button, GPIO_INPUT);
    if (ret != 0) {
        LOG_ERR("Failed to configure button pin: %d", ret);
        return ret;
    }

    ret = gpio_pin_interrupt_configure_dt(&button, GPIO_INT_EDGE_TO_ACTIVE);
    if (ret != 0) {
        LOG_ERR("Failed to configure button interrupt: %d", ret);
        return ret;
    }

    gpio_init_callback(&button_cb_data, button_pressed, BIT(button.pin));
    gpio_add_callback(button.port, &button_cb_data);

    LOG_INF("🔘 Button initialized successfully");
    LOG_INF("Press button to cycle through events:");
    LOG_INF("  Event 0: PI_START");
    LOG_INF("  Event 1: OBSTACLE");
    LOG_INF("  Event 2: OBSTACLE_CLEAR");
    LOG_INF("  Event 3: PI_STOP");
    LOG_INF("  Event 4: LOW_BATTERY");
    LOG_INF("  Event 5: PI_START (repeat)");

    return 0;
}

/* Initialize button on startup */
// SYS_INIT(button_init, APPLICATION, CONFIG_APPLICATION_INIT_PRIORITY); // this function is executed on start up
```

## src/error_handling.c
```c
#include <zephyr/kernel.h>
#include <zephyr/logging/log_ctrl.h>   // log_panic(), log_process()
// #include <zephyr/power/reboot.h>       // sys_reboot()
#include <zephyr/irq.h>

// To invoke a fatal error, use: k_panic(), or k_oops() [kills current thread], or __ASSERT();
// See: https://docs.zephyrproject.org/latest/kernel/services/other/fatal.html

__attribute__((noreturn))
// This function is defined weak in Zephyr and we overrides the default handler here
void k_sys_fatal_error_handler(unsigned int reason, const struct arch_esf *esf)
{
    ARG_UNUSED(esf);

    /* 1) Enter panic mode: backends block; pending logs are flushed */
    log_panic();
    while (log_process()) {
        /* drain remaining messages */
    }

    /* 2) Put the system in a safe mode */
    // motors_disable();   // your functions
    // arm_brake();

    /* 3) Choose your policy: halt forever (matches your requirement) */
    k_fatal_halt(reason);  // never returns

    /* Alternative: reboot instead */
    // sys_reboot(SYS_REBOOT_COLD);
    // CODE_UNREACHABLE;
}
```

## src/scheduler.c
```c
/**
 * @file    scheduler.c
 * @brief   Smart Roomba MCU scheduler implementation
 * @author  Jacky Lim
 * @date    August 2025
 * @details This file implements the scheduler for the Smart Roomba MCU. The defined control loops
 *          use a hardware timer to trigger a 1 kHz loop, which derives 100 Hz and 10 Hz loops.
 *          Relative timing is used to ensure that the 100 Hz and 10 Hz loops are phase-locked to the 1 kHz loop.
 */
#include <zephyr/kernel.h>
#include <zephyr/device.h>
#include <zephyr/drivers/counter.h>
#include <zephyr/logging/log.h>
LOG_MODULE_REGISTER(sched, LOG_LEVEL_INF);

/* ----- Semaphores for periodic loops ----- */
K_SEM_DEFINE(sem_1khz, 0, K_SEM_MAX_LIMIT);
K_SEM_DEFINE(sem_100hz, 0, K_SEM_MAX_LIMIT);
K_SEM_DEFINE(sem_10hz, 0, K_SEM_MAX_LIMIT);

/* ----- Aperiodic IPC ----- */
#define RX_MSGQ_ITEM_SZ   32
#define RX_MSGQ_DEPTH     16
K_MSGQ_DEFINE(rx_msgq, RX_MSGQ_ITEM_SZ, RX_MSGQ_DEPTH, 4);

/* ----- Timer alarm (1 kHz) ----- */
static const struct device *timer = DEVICE_DT_GET(DT_ALIAS(counter0));
static struct counter_alarm_cfg alarm_cfg;
static volatile uint32_t div_100 = 0, div_10 = 0;

static uint32_t period_ticks = 0; // Will be set in init

static void alarm_cb(const struct device *dev, uint8_t chan_id, uint32_t ticks, void *user_data)
{
    ARG_UNUSED(dev); ARG_UNUSED(chan_id); ARG_UNUSED(ticks); ARG_UNUSED(user_data);

    /* Release 1 kHz loop */
    k_sem_give(&sem_1khz);

    /* Derive 100 Hz and 10 Hz from same tick for phase-lock */
    /* We derive 100 Hz and 10 Hz this way to prevent drift */
    if (++div_100 >= 10) { 
        div_100 = 0; 
        k_sem_give(&sem_100hz); 
    }
    if (++div_10  >= 100){ 
        div_10  = 0; 
        k_sem_give(&sem_10hz);  
    }

    /* Re-arm next alarm (periodic) */
    alarm_cfg.flags = COUNTER_ALARM_CFG_EXPIRE_WHEN_LATE; /* absolute time */
    alarm_cfg.ticks = period_ticks;
    int ret = counter_set_channel_alarm(dev, 0, &alarm_cfg);
    if (ret != 0) {
            LOG_ERR("Failed to set alarm: %d", ret);
    }
}

/* ----- Periodic threads ----- */
static void loop_1khz(void *a, void *b, void *c)
{
    ARG_UNUSED(a); ARG_UNUSED(b); ARG_UNUSED(c);

    while (1) {
        k_sem_take(&sem_1khz, K_FOREVER);

        /* BEGIN 1 kHz critical section (keep < ~60–70% of 1ms budget) */
        // read encoders (non-blocking / cached)
        // run inner motor PID
        // write PWM setpoints
        /* END */

        /* Avoid any logging here; if needed, count and log at 10 Hz */
    }
}

static void loop_100hz(void *a, void *b, void *c)
{
    ARG_UNUSED(a); ARG_UNUSED(b); ARG_UNUSED(c);

    static uint32_t counter_100hz = 0;
    while (1) {
        k_sem_take(&sem_100hz, K_FOREVER);

        if ((counter_100hz++ % 100) == 0) {
            LOG_DBG("100Hz loop executed");
        }
        // IMU read (cached or via server thread)
        // state estimation / EKF step
        // trajectory tracking outer loop
        // LOG_DBG("100Hz loop executed");
    }
}

static void loop_10hz(void *a, void *b, void *c)
{
    ARG_UNUSED(a); ARG_UNUSED(b); ARG_UNUSED(c);

    static uint32_t cnt = 0;
    while (1) {
        k_sem_take(&sem_10hz, K_FOREVER);

        // housekeeping, BMS polling, health, publishing slow telemetry
        if ((cnt++ % 10) == 0) {
            LOG_DBG("10Hz: health ok");
        }
    }
}

/* ----- Aperiodic worker ----- */
static void worker_rx(void *a, void *b, void *c)
{
    ARG_UNUSED(a); ARG_UNUSED(b); ARG_UNUSED(c);
    uint8_t buf[RX_MSGQ_ITEM_SZ];

    // This thread processes incoming messages from the RX queue
    // Only runs when there are messages in the queue
    while (1) {
        if (k_msgq_get(&rx_msgq, buf, K_FOREVER) == 0) {
            LOG_DBG("Processing message");
            // parse/process one item (bounded work)
            // if heavy, schedule to system workqueue
        }
    }
}

/* ----- ISR example: UART RX bottom-half enqueue ----- */
void uart_rx_isr_handler(const uint8_t *data, size_t len)
{
    /* Copy minimal data; drop on overflow (non-blocking) */
    size_t cpy = MIN(len, RX_MSGQ_ITEM_SZ);
    uint8_t buf[RX_MSGQ_ITEM_SZ];
    memcpy(buf, data, cpy);

    // Put the message into the queue
    if (k_msgq_put(&rx_msgq, buf, K_NO_WAIT) != 0) {
        LOG_WRN("Message queue full, dropping data");
        /* optional: increment drop counter */
    }
}

/* ----- Init & thread creation ----- */
K_THREAD_STACK_DEFINE(stack_1k, 2048);
K_THREAD_STACK_DEFINE(stack_100, 2048);
K_THREAD_STACK_DEFINE(stack_10, 2048);
K_THREAD_STACK_DEFINE(stack_rx, 2048);
static struct k_thread th_1k, th_100, th_10, th_rx;

static int scheduler_init(void)
{
    LOG_INF("Initializing scheduler...");

    /* Counter init at 1 kHz alarms */
    if (!device_is_ready(timer)) {
        LOG_ERR("Counter device not ready: %s", timer->name);
        return -ENODEV;
    }

    /* Calculate period_ticks for 1kHz (1ms period) */
    period_ticks = counter_us_to_ticks(timer, 1000); /* 1000 microseconds */
    if (period_ticks == 0) {
        LOG_ERR("Invalid period calculation");
        return -EINVAL;
    }

    LOG_DBG("Timer frequency: %u Hz, period_ticks for 1kHz: %u", 
            counter_get_frequency(timer), period_ticks);

    /* Configure alarm for 1kHz (1ms period) */
    alarm_cfg.flags = COUNTER_ALARM_CFG_EXPIRE_WHEN_LATE; /* relative time */
    alarm_cfg.callback = alarm_cb;
    alarm_cfg.user_data = NULL;
    alarm_cfg.ticks = period_ticks;

    /* Start the counter */
    int ret = counter_start(timer);
    if (ret != 0) {
        LOG_ERR("Failed to start counter: %d", ret);
        return ret;
    }
    
    // Set alarm
    ret = counter_set_channel_alarm(timer, 0, &alarm_cfg);
    if (ret != 0) {
        LOG_ERR("Failed to set initial alarm: %d", ret);
        return ret;
    }

    /* Create threads with rate-monotonic priority */
    k_thread_create(&th_1k, stack_1k, K_THREAD_STACK_SIZEOF(stack_1k),
                    loop_1khz, NULL, NULL, NULL, 0 /* highest prio */, 0, K_NO_WAIT);
    k_thread_name_set(&th_1k, "loop_1k");

    k_thread_create(&th_100, stack_100, K_THREAD_STACK_SIZEOF(stack_100),
                    loop_100hz, NULL, NULL, NULL, 1, 0, K_NO_WAIT);
    k_thread_name_set(&th_100, "loop_100");

    k_thread_create(&th_10, stack_10, K_THREAD_STACK_SIZEOF(stack_10),
                    loop_10hz, NULL, NULL, NULL, 2, 0, K_NO_WAIT);
    k_thread_name_set(&th_10, "loop_10");

    k_thread_create(&th_rx, stack_rx, K_THREAD_STACK_SIZEOF(stack_rx),
                    worker_rx, NULL, NULL, NULL, 3, 0, K_NO_WAIT);
    k_thread_name_set(&th_rx, "worker_rx");

    LOG_INF("Scheduler initialized successfully");
    return 0;
}

SYS_INIT(scheduler_init, APPLICATION, 50);
```

## src/state_machine.c
```c
/**
 * @file    state_machine.c
 * @brief   Smart Roomba MCU state machine implementation
 * @author  Jacky Lim
 * @date    July 2025
 * @details This file implements the state machine for the Smart Roomba MCU
 * 
 */
#include "state_machine.h"

#include <zephyr/kernel.h>
#include <zephyr/smf.h>
#include <zephyr/logging/log.h>

LOG_MODULE_REGISTER(state_machine, LOG_LEVEL_DBG); // Change to LOG_LEVEL_DBG for later

/* FSM context */
struct robot {
    struct smf_ctx ctx;
    
    /* User defined variables */
    struct k_event evt; // Kernel event object
    uint32_t events;
    bool motors_on;
    bool vacuum_on;
    robot_state_t current_state; 
};

/* Define FSM instance */
static struct robot robo_fsm;
static const struct smf_state state_table[STATE_MAX];

/* ---------- STATE: IDLE ---------- */
static void idle_entry(void *o)
{
    LOG_DBG("Entering IDLE state\n");

    // struct robot *r = (struct robot *)o;
    // LOG_INF("STM32: IDLE - motors stopped");
    
    // stop_motors();
    // r->motors_on = false;
    // r->vacuum_on = false;
    // report_to_pi("IDLE");
}

static void idle_run(void *o)
{
    struct robot *r = (struct robot *)o;
    if (r->events & EVT_PI_START) {
        LOG_INF("In idle_run function\n");
        smf_set_state(SMF_CTX(r), &state_table[STATE_ACTIVE]);
        r->current_state = STATE_ACTIVE; // Update current state
    }
}

static void idle_exit(void *o)
{
    LOG_DBG("Exiting IDLE state\n");
}

/* ---------- STATE: Active ---------- */
static void active_entry(void *o)
{
    LOG_DBG("Entering active state\n");

    // struct robot *r = (struct robot *)o;
    // LOG_INF("STM32: MOVING - following Pi commands");
    
    // start_motors();
    // r->motors_on = true;
    // r->vacuum_on = true;
    // report_to_pi("MOVING");
}

static void active_run(void *o)
{
    struct robot *r = (struct robot *)o;

    if (r->events & EVT_OBSTACLE) {
        LOG_WRN("SAFETY: Obstacle detected - overriding Pi");
        smf_set_state(SMF_CTX(r), &state_table[STATE_AVOIDING]);
        r->current_state = STATE_AVOIDING; // Update current state
        // TODO: how will the pi handle this?
    }

    if (r->events & EVT_PI_STOP) {
        LOG_INF("In active_run function\n");
        smf_set_state(SMF_CTX(r), &state_table[STATE_IDLE]);
        r->current_state = STATE_IDLE; // Update current state
    }

    if (r->events & EVT_LOW_BATTERY) {
        LOG_WRN("BATTERY: Low battery - returning to dock");
        smf_set_state(SMF_CTX(r), &state_table[STATE_IDLE]);
        r->current_state = STATE_IDLE; // Update current state
    }
}

static void active_exit(void *o)
{
    LOG_DBG("Exiting ACTIVE state\n");
}

/* ---------- STATE: AVOIDING ---------- */
static void avoiding_entry(void *o)
{
    LOG_DBG("Entering avoiding state\n");

    // struct robot *r = (struct robot *)o;
    // LOG_WRN("STM32: AVOIDING - safety override active");
    
    // stop_motors();  // Immediate stop
    // r->motors_on = false;
    // report_to_pi("AVOIDING_OBSTACLE");
}

static void avoiding_run(void *o)
{
    struct robot *r = (struct robot *)o;

    if (r->events & EVT_OBSTACLE_CLEAR) {
        LOG_INF("Obstacle cleared - returning control to Pi");
        smf_set_state(SMF_CTX(r), &state_table[STATE_IDLE]);
        r->current_state = STATE_IDLE; // Update current state
    }
    /* Pi can override if it has a plan */
    if (r->events & EVT_PI_START) {
        LOG_INF("Pi override - resuming movement");
        smf_set_state(SMF_CTX(r), &state_table[STATE_ACTIVE]);
        r->current_state = STATE_ACTIVE; // Update current state
    }
}

static void avoiding_exit(void *o) {
    LOG_DBG("Leaving AVOIDING\n");
}

/* State table - much simpler! */
static const struct smf_state state_table[STATE_MAX] = {
    [STATE_IDLE] = SMF_CREATE_STATE(idle_entry, idle_run, idle_exit, NULL, NULL),
    [STATE_ACTIVE] = SMF_CREATE_STATE(active_entry, active_run, active_exit, NULL, NULL),
    [STATE_AVOIDING] = SMF_CREATE_STATE(avoiding_entry, avoiding_run, avoiding_exit, NULL, NULL)
};

/* ---- Public posting API (other files call these) ---- */
void sm_post(uint32_t event_bits)
{
    /* k_event_post is ISR-safe; no extra locking needed */
    k_event_post(&robo_fsm.evt, event_bits);
}

/* Typed helpers for readability */
void sm_post_obstacle(void)       { sm_post(EVT_OBSTACLE); }
void sm_post_obstacle_clear(void) { sm_post(EVT_OBSTACLE_CLEAR); }
void sm_post_low_battery(void)    { sm_post(EVT_LOW_BATTERY); }


void fsm_thread(void)
{
    int ret = 0;
    LOG_INF("Starting FSM thread...");

    // Initialize the FSM
    memset(&robo_fsm, 0, sizeof(robo_fsm));
    k_event_init(&robo_fsm.evt);

    smf_set_initial(SMF_CTX(&robo_fsm), &state_table[STATE_IDLE]);
    LOG_INF("STM32 state machine initialized and ready. In Idle state.");

    /* Mask of all events this thread should react to */
    const uint32_t ALL_EVENTS =
        EVT_PI_START | EVT_PI_STOP |
        EVT_OBSTACLE | EVT_OBSTACLE_CLEAR |
        EVT_LOW_BATTERY | EVT_DOCK_FOUND;

    while (1) {
        robo_fsm.events = k_event_wait(&robo_fsm.evt, ALL_EVENTS, /*reset=*/true, K_FOREVER);
        LOG_DBG("FSM thread woke up with events: 0x%08X", robo_fsm.events);
        ret = smf_run_state(SMF_CTX(&robo_fsm));
        robo_fsm.events = 0;

        if (ret) {
            LOG_ERR("State machine error: %d", ret);
            // Handle error, maybe reset or log
            break;
        }
    }
}

/* ---------- Main Entry ---------- */
K_THREAD_DEFINE(fsm_tid, 1024, fsm_thread, NULL, NULL, NULL, 5, 0, 0);  // This defines the thread and starts it immediately

#ifdef CONFIG_TEST
int sm_test_get_state(void)
{
    return robo_fsm.current_state;
}

void sm_test_init(void)
{
    memset(&robo_fsm, 0, sizeof(robo_fsm));
    k_event_init(&robo_fsm.evt);
    smf_set_initial(SMF_CTX(&robo_fsm), &state_table[STATE_IDLE]);
}

void sm_test_run_step(void)
{
    /* consume one batch of events (if any) and run one SMF step */
    (void)smf_run_state(SMF_CTX(&robo_fsm));
}
#endif
```
